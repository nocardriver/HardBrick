/**
 * @file    display_text.c
 * @author  YangKY
 * @brief   5x5 点阵字体渲染实现
 *
 * 字模来源：Matej Artnak, "ILI9341 Driver library for STM32" (MIT License)。
 * 每个字符 6 列，每列 1 字节，bit0~bit7 对应单元内的第 0~7 行；
 * 实际墨迹只在第 2~6 行（5 行），所以视觉上是 5x5 字形。
 */

#include "display_text.h"

#include <string.h>

/** 96 个可打印 ASCII 字符（0x20 ~ 0x7F）的字模 */
static const uint8_t g_font[96][6] = {
  {0x00, 0x00, 0x00, 0x00, 0x00, 0x00},   /* (space) */
  {0x5c, 0x00, 0x00, 0x00, 0x00, 0x00},   /* ! */
  {0x06, 0x00, 0x06, 0x00, 0x00, 0x00},   /* " */
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  {0x00, 0x00, 0x00, 0x00, 0x00, 0x00},   /* DEL */
};

/**
 * @brief 在缓冲区内画一个 scale x scale 的实心方块（越界像素直接丢弃）
 */
static void display_text_put_block(uint8_t *dst, uint16_t w, uint16_t h,
                                   int16_t x, int16_t y, uint8_t scale,
                                   uint8_t fg_hi, uint8_t fg_lo)
{
  int16_t py;
  int16_t px;

  for (py = 0; py < (int16_t)scale; py++) {
    int16_t ty = (int16_t)(y + py);

    if ((ty < 0) || (ty >= (int16_t)h)) {
      continue;
    }
    for (px = 0; px < (int16_t)scale; px++) {
      int16_t tx = (int16_t)(x + px);
      uint32_t idx;

      if ((tx < 0) || (tx >= (int16_t)w)) {
        continue;
      }
      idx = ((uint32_t)ty * w + (uint16_t)tx) * 2u;
      dst[idx]      = fg_hi;
      dst[idx + 1u] = fg_lo;
    }
  }
}

uint16_t display_text_width(const char *text, uint8_t scale)
{
  size_t len;

  if (!text || (scale == 0u)) {
    return 0u;
  }

  len = strlen(text);
  if (len == 0u) {
    return 0u;
  }

  /* 最后一列是字符间距，算视觉宽度时扣掉 */
  return (uint16_t)((len * DISPLAY_TEXT_CELL_W * scale) - scale);
}

void display_text_render(uint8_t *dst, uint16_t w, uint16_t h,
                         const char *text, uint8_t scale,
                         uint16_t fg, uint16_t bg,
                         display_text_align_t align)
{
  uint32_t count;
  uint32_t i;
  uint16_t tw;
  uint16_t len;
  uint16_t n;
  int32_t  tmp;
  int16_t  x0;
  int16_t  y0;
  uint8_t  fg_hi = (uint8_t)(fg >> 8);
  uint8_t  fg_lo = (uint8_t)(fg & 0xFFu);

  if (!dst || (w == 0u) || (h == 0u)) {
    return;
  }

  /* 背景：大端 RGB565 */
  count = (uint32_t)w * h;
  for (i = 0u; i < count; i++) {
    dst[2u * i]      = (uint8_t)(bg >> 8);
    dst[2u * i + 1u] = (uint8_t)(bg & 0xFFu);
  }

  if (!text || (scale == 0u)) {
    return;
  }

  len = (uint16_t)strlen(text);
  if (len == 0u) {
    return;
  }

  tw = display_text_width(text, scale);
  if (tw > w) {
    /* 超宽：只画能放下的字符数，右侧截断 */
    len = (uint16_t)(w / (DISPLAY_TEXT_CELL_W * scale));
    if (len == 0u) {
      return;
    }
    tw = (uint16_t)((len * DISPLAY_TEXT_CELL_W * scale) - scale);
  }

  switch (align) {
  case DISPLAY_TEXT_CENTER:
    x0 = (int16_t)(((int32_t)w - (int32_t)tw) / 2);
    break;
  case DISPLAY_TEXT_RIGHT:
    x0 = (int16_t)((int32_t)w - (int32_t)tw);
    break;
  case DISPLAY_TEXT_LEFT:
  default:
    x0 = 0;
    break;
  }

  tmp = (int32_t)h - ((int32_t)DISPLAY_TEXT_INK_H * scale);
  y0 = (tmp > 0) ? (int16_t)(tmp / 2) : 0;

  for (n = 0u; n < len; n++) {
    const uint8_t *glyph;
    uint8_t ch = (uint8_t)text[n];
    uint8_t col;
    uint8_t row;
    int16_t cx;

    if ((ch < 0x20u) || (ch > 0x7Fu)) {
      ch = (uint8_t)'?';
    }
    glyph = g_font[ch - 0x20u];
    cx = (int16_t)(x0 + (int16_t)((uint32_t)n * DISPLAY_TEXT_CELL_W * scale));

    for (col = 0u; col < DISPLAY_TEXT_INK_W; col++) {
      uint8_t bits = glyph[col];

      for (row = 0u; row < DISPLAY_TEXT_INK_H; row++) {
        if ((bits & (uint8_t)(1u << (row + 2u))) != 0u) {
          display_text_put_block(dst, w, h,
                                 (int16_t)(cx + ((int16_t)col * scale)),
                                 (int16_t)(y0 + ((int16_t)row * scale)),
                                 scale, fg_hi, fg_lo);
        }
      }
    }
  }
}
